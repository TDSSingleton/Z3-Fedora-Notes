## uniloader-work/q2q_defconfig
```kconfig
CONFIG_POSITION_INDEPENDENT=y
CONFIG_LINUX_KRNL_HEADER_IMG=y
CONFIG_SM8350=y
CONFIG_SAMSUNG_Q2Q=y
CONFIG_TEXT_BASE=0x9bb00000
CONFIG_PAYLOAD_ENTRY=0xc0000000
CONFIG_RAMDISK_ENTRY=0xcc000000
```
